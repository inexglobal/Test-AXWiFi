#include <ESP8266WiFi.h>
#include <SPI.h>
#include <Wire.h>                     // Include Wire.h for I2C functionality
//#include <ADS7828.h>                  // Include ADS7828.h for TI ADS7828 functions
#include <Adafruit_GFX.h>
#include <Adafruit_SSD1306.h>
#include <Adafruit_NeoPixel.h>
#include <Ticker.h>

#define NUMSLEDs  2
#define PINSLEDs  10
Adafruit_NeoPixel SLEDs = Adafruit_NeoPixel(NUMSLEDs, PINSLEDs, NEO_RGB + NEO_KHZ800);


Adafruit_SSD1306 OLED(-1);

#define PIN_SLED 10
#define pinTone D8
const unsigned char Logo_bmp [] = {
0x00, 0x00, 0x00, 0x00, 0x0F, 0x80, 0x00, 0x00, 0x00, 0x00, 0x00, 0x00, 0x00, 0x00, 0x00, 0x00,
0x3F, 0xC0, 0x00, 0x00, 0x00, 0x00, 0x00, 0x00, 0x00, 0x00, 0x00, 0x00, 0xFF, 0xF0, 0x00, 0x00,
0x00, 0x00, 0x00, 0x00, 0x00, 0x00, 0x00, 0x01, 0xFF, 0xFC, 0x00, 0x00, 0x00, 0x00, 0x00, 0x00,
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0x00, 0x78, 0x1C, 0x00, 0x00, 0x00, 0x3F, 0xFF, 0xFC, 0x03, 0x80, 0xFE, 0x03, 0xF0, 0x1C, 0x00
};

void setup(){
  WiFi.mode(WIFI_STA);

  pinMode(10,OUTPUT);
  SLEDs.begin(); // This initializes the NeoPixel library.
  SLEDs.show(); // Initialize all SLEDs to 'off'
  OLED.begin(SSD1306_SWITCHCAPVCC, 0x3C);  // initialize with the I2C addr 0x3C (for the 128x64)
  // init done
    // invert the display
  OLED.clearDisplay();
  OLED.display();
  OLED.invertDisplay(true);
  delay(2000);
  OLED.invertDisplay(false);
  delay(1000);
  OLED.clearDisplay();
  OLED.drawBitmap(20,0,Logo_bmp,96,64,1);
  OLED.display();
  // Show image buffer on the display hardware.
  // Since the buffer is intialized with an Adafruit splashscreen
  // internally, this will display the splashscreen.
  OLED.display();
  delay(2000);

  // Clear the buffer.
  OLED.clearDisplay();
  OLED.setTextSize(1);
  OLED.setTextColor(WHITE);
  pinMode(10,OUTPUT);
  ScanWifi();
  pinMode(D0, INPUT_PULLUP);
  pinMode(D3, INPUT_PULLUP);
  pinMode(D4, INPUT_PULLUP);
  pinMode(D5, INPUT_PULLUP);
  pinMode(D6, INPUT_PULLUP);
  pinMode(D7, INPUT_PULLUP);
  pinMode(D9, INPUT_PULLUP);
  pinMode(D10, INPUT_PULLUP);

  
  SLEDs.begin(); // This initializes the NeoPixel library.
  SLEDs.show(); // Initialize all SLEDs to 'off'
  
  SLEDs.setPixelColor(0, SLEDs.Color(255,0, 0)); //Adjust brightness, Color red
  SLEDs.setPixelColor(1, SLEDs.Color(255,0, 0)); //Adjust brightness, Color blue
  SLEDs.show();
  delay(1000);
}
void loop() {
  OLED.clearDisplay();
  OLED.setCursor(0, 0);
  OLED.println("ADC = " + String(analogRead(A0)));
  OLED.setCursor(80, 0);
  OLED.println(String("D0 = ") + ((digitalRead(D0)==1)?"###":"0"));
  OLED.setCursor(80, 10);
  OLED.println(String("D3 = ") + ((digitalRead(D3)==1)?"###":"0"));
  OLED.setCursor(80, 20);
  OLED.println(String("D4 = ") + ((digitalRead(D4)==1)?"###":"0"));
  OLED.setCursor(80, 30);
  OLED.println(String("D5 = ") + ((digitalRead(D5)==1)?"###":"0"));
  OLED.setCursor(80, 40);
  OLED.println(String("D6 = ") + ((digitalRead(D6)==1)?"###":"0"));
  OLED.setCursor(80, 50);
  OLED.println(String("D7 = ") + ((digitalRead(D7)==1)?"###":"0"));
  OLED.setCursor(0, 40);
  OLED.println(String("D9 = ") + ((digitalRead(D9)==1)?"###":"0"));
  OLED.setCursor(0, 50);
  OLED.println(String("D10 = ") + ((digitalRead(D10)==1)?"###":"0"));
  OLED.display();

  int val = map(analogRead(A0), 9, 1023, 0, 255);
  val=constrain(val,0,255);
  SLEDs.setPixelColor(0, SLEDs.Color(val, val, val)); //Adjust brightness, Color red
  SLEDs.setPixelColor(1, SLEDs.Color(val, val, val)); //Adjust brightness, Color blue
  SLEDs.show();
  if (val > 128) {
    analogWrite(pinTone, 255);
  } else {
    analogWrite(pinTone, 0);
  }
  //(digitalRead(D0)==0?analogWrite(pinTone, 255):analogWrite(pinTone,0));
  if(digitalRead(D3)==0){analogWrite(pinTone, 255);}
  if(digitalRead(D4)==0){analogWrite(pinTone, 255);}
  if(digitalRead(D5)==0){analogWrite(pinTone, 255);}
  if(digitalRead(D6)==0){analogWrite(pinTone, 255);}
  if(digitalRead(D7)==0){analogWrite(pinTone, 255);}
  if(digitalRead(D9)==0){analogWrite(pinTone, 255);}
  if(digitalRead(D10)==0){analogWrite(pinTone, 255);}
  
}
void ScanWifi(){
  OLED.clearDisplay();
  OLED.setCursor(0, 0);
  OLED.println("scan start");
  OLED.display();
  // WiFi.scanNetworks will return the number of networks found
  int n = WiFi.scanNetworks();
  OLED.clearDisplay();
  OLED.setCursor(0, 0);
  OLED.println("scan done");
  if (n == 0)
    OLED.println("no networks found");
  else
  {
    OLED.print(n);
    OLED.println(" networks found");
    analogWrite(pinTone, 255);
    delay(100);
    analogWrite(pinTone, 0);
    for (int i = 0; i < 3; ++i)
    {
      // Print SSID and RSSI for each network found
      OLED.print(i + 1);
      OLED.print(": ");
      OLED.println(WiFi.SSID(i));
      /*
      OLED.print(" (");
      OLED.print(WiFi.RSSI(i));
      OLED.print(")");
      OLED.println((WiFi.encryptionType(i) == ENC_TYPE_NONE)?" ":"*");
      */
      delay(10);
    }
  }
  OLED.println("");
  OLED.display();
  // Wait a bit before scanning again
  delay(2000);
}


